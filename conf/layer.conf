## conf/layer.conf
```bitbake
BBPATH .= ":${LAYERDIR}"

BBFILES += "${LAYERDIR}/recipes-*/*/*.bb \
            ${LAYERDIR}/recipes-*/*/*.bbappend"

BBFILE_COLLECTIONS += "devboard-mainline"
BBFILE_PATTERN_devboard-mainline := "^${LAYERDIR}/"
BBFILE_PRIORITY_devboard-mainline = "6"

LAYERDEPENDS_devboard-mainline = "core meta-linux-mainline"

LAYERSERIES_COMPAT_devboard-mainline = "gatesgarth"
```

## conf/machine/includes/kernel-version.inc
```bitbake
DEVBOARD_KERNEL ??= "stable"
PREFERRED_PROVIDER_virtual/kernel ?= "linux-${DEVBOARD_KERNEL}"
PREFERRED_VERSION_linux-stable ?= "5.9%"
```

## conf/machine/includes/rk3288.inc
```bitbake
require conf/machine/include/tune-cortexa17.inc
require conf/machine/include/soc-family.inc

SOC_FAMILY = "rk3288"

DEFAULTTUNE = "cortexa17hf-neon-vfpv4"

MACHINE_FEATURES = "usbhost"
SERIAL_CONSOLES ?= "115200;ttyS2"

KERNEL_IMAGETYPE = "zImage"
KBUILD_DEFCONFIG = "multi_v7_defconfig"

require kernel-version.inc

MACHINE_EXTRA_RRECOMMENDS += " \
	kernel-image \
	kernel-modules \
	kernel-devicetree \
	u-boot \
"

EXTRA_IMAGEDEPENDS += "u-boot"
WKS_FILE ?= "rk3288.wks"
IMAGE_FSTYPES ?= "tar.xz wic wic.bmap"

SPL_BINARY = "idbloader.img"

require uboot-distro.inc

UBOOT_EXTLINUX_CONSOLE = "console=ttyS2,115200"
```

## conf/machine/includes/rk3399.inc
```bitbake
require conf/machine/include/tune-cortexa72-cortexa53.inc
require conf/machine/include/soc-family.inc

SOC_FAMILY = "rk3399"

MACHINE_FEATURES = "usbhost"
SERIAL_CONSOLES ?= "1500000;ttyS2"

PREFERRED_PROVIDER_virtual/kernel = "linux-mainline"
KERNEL_IMAGETYPE = "Image"

MACHINE_EXTRA_RRECOMMENDS += " \
	kernel-image-image \
	kernel-modules \
	kernel-devicetree \
	u-boot \
"

EXTRA_IMAGEDEPENDS += "u-boot"
WKS_FILE ?= "rk3399.wks"
IMAGE_FSTYPES ?= "tar.xz wic wic.bmap"

UBOOT_MAKE_TARGET = "all u-boot.itb"
UBOOT_SUFFIX = "itb"
SPL_BINARY = "idbloader.img"

ATF_PLATFORM ?= "rk3399"
ATF_TARGET ?= "bl31"
ATF_SUFFIX ?= "elf"

require uboot-distro.inc

UBOOT_EXTLINUX_CONSOLE = "console=ttyS2,1500000"
```

## conf/machine/includes/sun8i-s3.inc
```bitbake
require conf/machine/include/tune-cortexa7.inc
require conf/machine/include/soc-family.inc

SOC_FAMILY = "sun8i-s3"

MACHINE_FEATURES = "usbhost"
SERIAL_CONSOLES ?= "115200n8;ttyS0"

KERNEL_IMAGETYPE = "zImage"
KBUILD_DEFCONFIG = "sunxi_defconfig"

require kernel-version.inc

MACHINE_EXTRA_RRECOMMENDS += " \
	kernel-image \
	kernel-modules \
	kernel-devicetree \
	u-boot \
"

EXTRA_IMAGEDEPENDS += "u-boot"
WKS_FILE ?= "sun8i.wks.in"
IMAGE_FSTYPES ?= "tar.xz wic wic.bmap"

SPL_BINARY = "u-boot-sunxi-with-spl.bin"

UBOOT_EXTLINUX_ROOT ?= "root=/dev/mmcblk0p1"

require uboot-distro.inc

UBOOT_EXTLINUX_CONSOLE = "console=ttyS0,115200n8"
```

## conf/machine/rk3288-firefly.conf
```bitbake
require includes/rk3288.inc

KERNEL_DEVICETREE = "rk3288-firefly.dtb"

MACHINE_EXTRA_RRECOMMENDS += " \
        linux-firmware-bcm4339 \
        linux-firmware-bcm4356 \
        linux-firmware-bcm43455 \
"
MACHINE_FEATURES += " wifi bluetooth"

UBOOT_MACHINE = "firefly-rk3288_defconfig"
```

## conf/machine/rk3288-tinkerboard.conf
```bitbake
require includes/rk3288.inc

KERNEL_DEVICETREE = "rk3288-tinker.dtb"

MACHINE_EXTRA_RRECOMMENDS += " \
        linux-firmware-rtl8723 \
"
MACHINE_FEATURES += " wifi bluetooth"

UBOOT_MACHINE = "tinker-rk3288_defconfig"
```

## conf/machine/rk3399-khadas-edge-v.conf
```bitbake
require includes/rk3399.inc

KERNEL_DEVICETREE = "rockchip/rk3399-khadas-edge-v.dtb"
UBOOT_EXTLINUX_FDT = "../rk3399-khadas-edge-v.dtb"

MACHINE_EXTRA_RRECOMMENDS += " \
        linux-firmware-bcm4356 \
"

MACHINE_FEATURES += " wifi bluetooth"

UBOOT_MACHINE = "khadas-edge-v-rk3399_defconfig"
```

## conf/machine/rk3399-nanopc-t4.conf
```bitbake
require includes/rk3399.inc

KERNEL_DEVICETREE = "rockchip/rk3399-nanopc-t4.dtb"
UBOOT_EXTLINUX_FDT = "../rk3399-nanopc-t4.dtb"

MACHINE_EXTRA_RRECOMMENDS += " \
        linux-firmware-bcm4356 \
"

MACHINE_FEATURES += " wifi bluetooth"

UBOOT_MACHINE = "nanopc-t4-rk3399_defconfig"
```

## conf/machine/rk3399-rockpro64.conf
```bitbake
require includes/rk3399.inc

KERNEL_DEVICETREE = "rockchip/rk3399-rockpro64.dtb"
UBOOT_EXTLINUX_FDT = "../rk3399-rockpro64.dtb"

UBOOT_MACHINE = "rockpro64-rk3399_defconfig"
```

## conf/machine/sun8i-s3-pinecube.conf
```bitbake
require includes/sun8i-s3.inc

DEVBOARD_KERNEL ?= "stable"
PREFERRED_VERSION_linux-stable = "5.10%"

KERNEL_DEVICETREE = "sun8i-s3-pinecube.dtb"

MACHINE_EXTRA_RRECOMMENDS += " \
"
MACHINE_FEATURES += " wifi bluetooth"

UBOOT_MACHINE = "pinecube_defconfig"
```

## wic/rk3288.wks
```
# Copyright (C) 2020 Garmin Ltd. or its subsidiaries
# Released under the MIT license (see COPYING.MIT for the terms)
#
# Disk layout
# Note that the reference documentation refers to 512 byte disk sectors, but
# wic uses 1KB blocks
#
#   Partition   Start Sector    Number of Sectors
#   loader1     64              8000
#   reserved1   8064            128
#   reserved2   8192            8192
#   loader2     16384           8192
#   atf         24576           8192
#
# More information can be found at http://rockchip.wikidot.com/partitions

bootloader --ptable gpt

part loader1	--align 32	--size 4000K	--source rawcopy --sourceparams="file=idbloader.img"
part reserved1	--align 4032	--size 64K	--label reserved1
part reserved2	--align 4096	--size 4096K	--label reserved2
part loader2	--align 8192	--size 4096K	--source rawcopy --sourceparams="file=u-boot.bin"
part atf	--align 12288	--size 4096K	--label atf
part /		--active 	--source rootfs --fstype=ext4	--label rootfs
```
